## drivers/gpu/arm/Kconfig
```kconfig
config MALI
	tristate "ARM Mali GPU modules"
	depends on ARM && m
        select UMP
        select MALI400
	default n
	help
	  This enables the generation of mali.ko and ump.ko.

source "drivers/gpu/arm/mali/Kconfig"
source "drivers/gpu/arm/ump/Kconfig"
```
